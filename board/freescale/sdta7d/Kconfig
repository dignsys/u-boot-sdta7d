## board/freescale/sdta7d/Kconfig
```kconfig
if TARGET_SDTA7D

config SYS_BOARD
	default "sdta7d"

config SYS_VENDOR
	default "freescale"

config SYS_SOC
	default "mx7"

config SYS_CONFIG_NAME
	default "sdta7d"

endif
```
